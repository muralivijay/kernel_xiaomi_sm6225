/dts-v1/;
/plugin/;

#include <dt-bindings/interrupt-controller/arm-gic.h>
#include "spes-sm5602.dtsi"

/ {
	model = "Qualcomm Technologies, Inc. SPES KHAJE IDP nopmi";
	compatible = "qcom,khaje-idp", "qcom,khaje", "qcom,idp";
	qcom,msm-id = <518 0x10000>;
	qcom,board-id = <0x40022 0>;
	qcom,pmic-id = <0x2D 0x0 0x0 0x0>;
};
