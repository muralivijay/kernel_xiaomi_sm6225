&mdss_mdp {
dsi_k7_38_0c_0a_video:
	qcom,mdss_dsi_panel_k7_38_0c_0a_fhdp_video {
		qcom,mdss-dsi-panel-name = "k7 38 0c 0a video mode fhdp dsi panel";
		qcom,mdss-dsi-panel-model = "xiaomi 38 0c 0a VIDEO PANEL";
		qcom,mdss-dsi-panel-type = "dsi_video_mode";
		qcom,dsi-ctrl-num = <0>;
		qcom,dsi-phy-num = <0>;
		qcom,mdss-dsi-panel-physical-type = "oled";
		qcom,mdss-dsi-virtual-channel-id = <0>;
		qcom,mdss-dsi-stream = <0>;
		qcom,mdss-dsi-h-left-border = <0>;
		qcom,mdss-dsi-h-right-border = <0>;
		qcom,mdss-dsi-v-top-border = <0>;
		qcom,mdss-dsi-v-bottom-border = <0>;
		qcom,mdss-dsi-bpp = <24>;
		qcom,mdss-dsi-color-order = "rgb_swap_rgb";
		qcom,mdss-dsi-underflow-color = <0xff>;
		qcom,mdss-dsi-border-color = <0>;
		qcom,mdss-dsi-h-sync-pulse = <0>;
		qcom,mdss-dsi-traffic-mode = "burst_mode";
		qcom,mdss-dsi-bllp-eof-power-mode;
		qcom,mdss-dsi-bllp-power-mode;
		qcom,mdss-dsi-tx-eot-append;
		qcom,mdss-dsi-lane-map = "lane_map_0123";
		qcom,mdss-dsi-lane-0-state;
		qcom,mdss-dsi-lane-1-state;
		qcom,mdss-dsi-lane-2-state;
		qcom,mdss-dsi-lane-3-state;
		qcom,mdss-dsi-dma-trigger = "trigger_sw";
		qcom,mdss-dsi-mdp-trigger = "none";
		qcom,mdss-dsi-lp11-init;
		qcom,mdss-dsi-bl-pmic-control-type = "bl_ctrl_dcs";
		qcom,mdss-dsi-bl-min-level = <1>;
		qcom,dispparam-enabled;
		qcom,mdss-dsi-bl-max-level = <2047>;
		qcom,mdss-dsi-bl-inverted-dbv;
		qcom,mdss-brightness-max-level = <2047>;
		qcom,mdss-dsi-reset-sequence = <1 10 0 10 1 10>;
		qcom,mdss-pan-physical-width-dimension = <67>;
		qcom,mdss-pan-physical-height-dimension = <149>;
		qcom,mdss-dsi-te-pin-select = <1>;
		qcom,mdss-dsi-wr-mem-start = <0x2c>;
		qcom,mdss-dsi-wr-mem-continue = <0x3c>;
		qcom,mdss-dsi-te-dcs-command = <1>;
		qcom,mdss-dsi-te-check-enable;
		qcom,mdss-dsi-te-using-te-pin;
		qcom,mdss-dsi-pan-enable-dynamic-fps;
		qcom,mdss-dsi-pan-fps-update = "dfps_immediate_porch_mode_vfp";
		qcom,dsi-supported-dfps-list = <90 60>;
		qcom,esd-err-irq-gpio = <&tlmm 99 0x2001>;
		qcom,esd-check-enabled;
		qcom,mdss-dsi-panel-status-check-mode = "reg_read";
		qcom,mdss-dsi-panel-status-command = <0x6010001 0x10a>;
		qcom,mdss-dsi-panel-status-command-state = "dsi_hs_mode";
		qcom,mdss-dsi-panel-status-value = <0x9d>;
		qcom,mdss-dsi-panel-on-check-value = <0x9d>;
		qcom,mdss-dsi-panel-status-read-length = <1>;
		qcom,platform-en-gpio = <&pm6125_gpios 9 0>;
		qcom,dsi-select-clocks = "mux_byte_clk0", "mux_pixel_clk0", "src_byte_clk0", "src_pixel_clk0", "shadow_byte_clk0", "shadow_pixel_clk0";
		qcom,panel-supply-entries = <&dsi_panel_pwr_supply_no_labibb>;
		qcom,platform-reset-gpio = <&tlmm 82 0>;

		qcom,mdss-dsi-display-timings {

			timing@0 {
				qcom,mdss-dsi-panel-width = <1080>;
				qcom,mdss-dsi-panel-height = <2400>;
				qcom,mdss-dsi-panel-framerate = <90>;
				qcom,mdss-dsi-h-pulse-width = <32>;
				qcom,mdss-dsi-h-back-porch = <120>;
				qcom,mdss-dsi-h-front-porch = <320>;
				qcom,mdss-dsi-h-sync-skew = <0>;
				qcom,mdss-dsi-v-pulse-width = <2>;
				qcom,mdss-dsi-v-back-porch = <10>;
				qcom,mdss-dsi-v-front-porch = <20>;
				qcom,mdss-dsi-on-command = [05 01 00 00 14 00 01 11 39 01 00 00 00 00 05 f1 5a 5a 5a 5a 39 01 00 00 00 00 05 b0 00 2c e0 01 39 01 00 00 00 00 0c e0 00 03 95 07 85 03 39 05 6d 05 51 39 01 00 00 00 00 05 b0 00 41 e0 01 39 01 00 00 00 00 02 e0 03 39 01 00 00 00 00 05 f1 a5 a5 a5 a5 39 01 00 00 00 00 03 f1 5a 5a 39 01 00 00 00 00 03 b2 01 30 39 01 00 00 00 00 03 f1 a5 a5 39 01 00 00 00 00 05 f1 5a 5a 5a 5a 39 01 00 00 00 00 05 b0 00 08 ea 01 39 01 00 00 00 00 03 ea f4 89 39 01 00 00 00 00 05 b0 00 0a ea 01 39 01 00 00 00 00 04 ea 55 01 04 39 01 00 00 00 00 05 b0 00 0d ea 01 39 01 00 00 00 00 03 ea ff ff 39 01 00 00 00 00 05 b0 00 74 e1 01 39 01 00 00 00 00 02 e1 3f 39 01 00 00 00 00 05 b0 00 10 ea 01 39 01 00 00 00 00 02 ea 01 39 01 00 00 00 00 05 f1 a5 a5 a5 a5 39 01 00 00 00 00 05 f1 5a 5a 5a 5a 39 01 00 00 00 00 05 b0 00 32 f6 01 39 01 00 00 00 00 06 f6 24 00 19 00 00 39 01 00 00 00 00 05 f1 a5 a5 a5 a5 39 01 00 00 00 00 03 f1 5a 5a 39 01 00 00 00 00 04 b0 00 09 cd 39 01 00 00 00 00 04 cd 08 48 20 39 01 00 00 00 00 03 f1 a5 a5 39 01 00 00 00 00 02 9d 01 39 01 00 00 00 00 5a 9e 11 00 00 89 30 80 09 60 04 38 00 28 02 1c 02 1c 02 00 02 0e 00 20 03 dd 00 07 00 0c 02 77 02 8b 18 00 10 f0 03 0c 20 00 06 0b 0b 33 0e 1c 2a 38 46 54 62 69 70 77 79 7b 7d 7e 01 02 01 00 09 40 09 be 19 fc 19 fa 19 f8 1a 38 1a 78 1a b6 2a f6 2b 34 2b 74 3b 74 6b f4 00 39 01 00 00 00 00 03 f1 5a 5a 39 01 00 00 00 00 02 60 21 39 01 00 00 00 00 02 f7 07 39 01 00 00 00 00 03 f1 a5 a5 39 01 00 00 00 00 03 f1 5a 5a 39 01 00 00 00 00 05 b0 00 0d b2 01 39 01 00 00 00 00 02 b2 20 39 01 00 00 00 00 05 b0 00 0c b2 01 39 01 00 00 00 00 02 b2 30 39 01 00 00 00 00 03 f1 a5 a5 39 01 00 00 00 00 02 53 30 39 01 00 00 64 00 02 f7 07 05 01 00 00 00 00 01 29];
				qcom,mdss-dsi-off-command = <0x5010000 0xa000128 0x5010000 0x96000110>;
				qcom,mdss-dsi-dispparam-hbm-on-command = [39 01 00 00 00 00 02 53 f0 39 01 00 00 00 00 03 51 07 ff];
				qcom,mdss-dsi-dispparam-hbm-off-command = [39 01 00 00 00 00 02 53 30];
				qcom,mdss-dsi-doze-hbm-command = [39 01 00 00 00 00 03 51 01 0e];
				qcom,mdss-dsi-doze-lbm-command = [39 01 00 00 00 00 03 51 00 14];
				qcom,mdss-dsi-dispparam-bc-90hz-command = [39 00 00 00 00 00 03 f1 5a 5a 39 00 00 00 00 00 02 60 01 39 00 00 00 00 00 02 f7 07 39 01 00 00 00 00 03 f1 a5 a5];
				qcom,mdss-dsi-dispparam-bc-60hz-command = [39 00 00 00 00 00 03 f1 5a 5a 39 00 00 00 00 00 02 60 21 39 00 00 00 00 00 02 f7 07 39 01 00 00 00 00 03 f1 a5 a5];
				qcom,mdss-dsi-flat-on-command = [39 01 00 00 00 00 03 f1 5a 5a 39 01 00 00 00 00 05 b0 00 88 b1 01 39 01 00 00 00 00 03 b1 27 2d 39 01 00 00 00 00 03 f1 a5 a5];
				qcom,mdss-dsi-flat-off-command = [39 01 00 00 00 00 03 f1 5a 5a 39 01 00 00 00 00 05 b0 00 88 b1 01 39 01 00 00 00 00 03 b1 27 0d 39 01 00 00 00 00 03 f1 a5 a5];
				qcom,mdss-dsi-on-command-state = "dsi_lp_mode";
				qcom,mdss-dsi-off-command-state = "dsi_lp_mode";
				qcom,mdss-dsi-hbm1-on-command-state = "dsi_lp_mode";
				qcom,mdss-dsi-hbm2-on-command-state = "dsi_lp_mode";
				qcom,mdss-dsi-dispparam-hbm-on-command-state = "dsi_lp_mode";
				qcom,mdss-dsi-dispparam-hbm-off-command-state = "dsi_lp_mode";
				qcom,mdss-dsi-doze-hbm-command-state = "dsi_lp_mode";
				qcom,mdss-dsi-doze-lbm-command-state = "dsi_lp_mode";
				qcom,mdss-dsi-dispparam-bc-90hz-command-state = "dsi_hs_mode";
				qcom,mdss-dsi-dispparam-bc-60hz-command-state = "dsi_hs_mode";
				qcom,mdss-dsi-flat-on-command-state = "dsi_lp_mode";
				qcom,mdss-dsi-flat-off-command-state = "dsi_lp_mode";
				qcom,compression-mode = "dsc";
				qcom,mdss-dsc-slice-height = <20>;
				qcom,mdss-dsc-slice-width = <540>;
				qcom,mdss-dsc-slice-per-pkt = <1>;
				qcom,mdss-dsc-bit-per-component = <8>;
				qcom,mdss-dsc-bit-per-pixel = <8>;
				qcom,mdss-dsc-block-prediction-enable;
				qcom,mdss-dsi-panel-phy-timings = [00 24 09 0a 1a 25 09 0a 09 02 04 00 1e 0f];
				qcom,display-topology = <1 1 1>;
				qcom,default-topology-index = <0>;
			};
		};
	};
};				
